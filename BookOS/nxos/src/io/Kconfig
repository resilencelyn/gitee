## BookOS/nxos/src/io/Kconfig
```kconfig
config NX_IRQ_NAME_LEN
    int "irq name length"
    default 48

config NX_NR_IRQS
    int "irq numbers"
    default 0
    
```

## BookOS/nxos/src/mm/Kconfig
```kconfig
config NX_KVADDR_OFFSET
    hex "kernel virtual address offset to physic address"
    default 0x00000000

config NX_PAGE_SHIFT
    int "page size shift"
    default 12
```
